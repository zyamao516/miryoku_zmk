/* Provide the label that the nice_view shield requires */
nice_view_spi: &spi1 {
    status = "okay";
    /* CS pin must match your wiring (often D1 on nice!nano v2 builds) */
    /* If you already know it, set it here; otherwise copy the known-good overlay from ZMK */
    cs-gpios = <&gpio0 6 GPIO_ACTIVE_LOW>;
};
