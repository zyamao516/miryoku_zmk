// Copyright 2021 Manna Harbour
// https://github.com/manna-harbour/miryoku

#include "../miryoku/custom_config.h"
#include "../miryoku/mapping/42/corne.h"
#include "../miryoku/miryoku.dtsi"
/* nice!view needs a labeled SPI bus */
nice_view_spi: &spi1 {
  cs-gpios = <&pro_micro 4 GPIO_ACTIVE_HIGH>;
};
